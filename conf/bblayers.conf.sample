## conf/bblayers.conf.sample
```bitbake
# LAYER_CONF_VERSION is increased each time build/conf/bblayers.conf
# changes incompatibly
LCONF_VERSION = "6"

BBPATH = "${TOPDIR}"
BBFILES ?= ""

BBLAYERS ?= " \
  /software/bpp3/system/poky/meta \
  /software/bpp3/system/poky/meta-yocto \
  /software/bpp3/system/poky/meta-yocto-bsp \
  /software/bpp3/system/poky/meta-bpp3 \
  "
```

## conf/layer.conf
```bitbake
# add conf and classes directory to BBPATH
BBPATH := "${BBPATH}:${LAYERDIR}"

# add the recipes to BBFILES
BBFILES := "${BBFILES} ${LAYERDIR}/recipes-*/*/*.bb \
	${LAYERDIR}/recipes-*/*/*.bbappend \
	${LAYERDIR}/recipes-*/*/*/*.bbappend"

BBFILE_COLLECTIONS += "bpp3"
BBFILE_PATTERN_bpp3 := "^${LAYERDIR}/"
BBFILE_PRIORITY_bpp3 = "6"
```

## conf/machine/bpp3.conf
```bitbake
#@TYPE: Machine
#@NAME: bpp3 board
#@DESCRIPTION: Machine configuration for bpp3 board

# use defaults for armv7a, processor is TI AM3517
DEFAULTTUNE = "armv7a-neon"

require conf/machine/include/arm/arch-armv7a.inc

# variable needed for compilation
MACHINE_FEATURES ?= "ext2 keyboard screen serial usbgadget usbhost"

PREFERRED_PROVIDER_virtual/kernel ?= "linux-bpp3"
PREFERRED_PROVIDER_virtual/bootloader = "u-boot"
PREFERRED_VERSION_u-boot = "2012.07"

# works with new kernel from git (fixme, download a tar not the git repro)
#PREFERRED_VERSION_linux-htkw_mcx ?= "3.4%"

# generate uImage variant of linux kernel
KERNEL_IMAGETYPE = "uImage"

# generate flattened device tree - not yet supported
#KERNEL_DEVICETREE = "${S}/arch/arm/boot/dts/enbw_cmc.dts"

# as minimum ubifs format of rootfs is required to program nand memory
IMAGE_FSTYPES += "ubifs"
MKUBIFS_ARGS = "--min-io-size=2048 --leb-size=129024 --max-leb-cnt=900"

# use specific u-boot from git
#EXTRA_IMAGEDEPENDS += "u-boot-mcx"

# custom file system permissions file - needed to allow logging to the fs instead of volatile
#FILESYSTEM_PERMS_TABLES="${COREBASE}/meta-eldk/recipes-mcx/files/fs-perms.txt"

# config of u-boot to be used
UBOOT_MACHINE = "bpp3_config"
UBOOT_ENTRYPOINT = "0x80008000"
UBOOT_LOADADDRESS = "0x80008000"

# parameters for sysvinit inittab
SERIAL_CONSOLE = "115200 ttyO0"
```
